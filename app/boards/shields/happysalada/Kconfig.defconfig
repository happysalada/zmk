## app/boards/shields/happysalada/Kconfig.defconfig
```kconfig
if SHIELD_HAPPYSALADA_LEFT

config ZMK_KEYBOARD_NAME
	default "Happysalada"

config ZMK_SPLIT_BLE_ROLE_CENTRAL
	default y

endif

if SHIELD_HAPPYSALADA_LEFT || SHIELD_HAPPYSALADA_RIGHT

config ZMK_SPLIT
	default y
 
if ZMK_DISPLAY

config I2C
	default y

config SSD1306
	default y

config SSD1306_REVERSE_MODE
	default y

endif # ZMK_DISPLAY

endif
```
